#include <hardware/gpio.h>
#include <pico/stdio.h>
#include <pico/time.h>
#include <stdarg.h>
#include <stdint.h>
#include <stdio.h>

#include "pico/stdlib.h"
#include "hardware/pio.h"
#include "hello.pio.h"

#ifndef PICO_DEFAULT_LED_PIN
#define PICO_DEFAULT_LED_PIN 25
#endif

void picoshiftOut(uint8_t dataPin, uint8_t clockPin, uint8_t latchPin, uint8_t val) {
    uint8_t i;
    for (i = 0; i < 8; i++)  {
        gpio_put(dataPin, (val & 128) != 0);
        sleep_us(1);
        gpio_put(clockPin, true);
        sleep_us(1);
        gpio_put(clockPin, false);    
        val = (val << 1);    
    }
    gpio_put(latchPin, true);
    sleep_us(1);
    gpio_put(latchPin, false);
} 


int main() {
    stdio_init_all();
    PIO pio;
    uint sm;
    uint offset;
    // On Pico W, the onboard LED is connected to the WiFi chip and cannot be driven by PIO directly.
    // We must use an external LED on a regular GPIO pin.
    // Let's use GPIO 20 as in the original code (Pin 26 on the board).
    uint led_pin = 20;

    // Use shift register pins: Data=16, Latch=17, Clock=18
    uint data_pin = 16;
    uint latch_pin = 17;
    uint clock_pin = 18;

    setup_default_uart();
    bool success = pio_claim_free_sm_and_add_program_for_gpio_range(&hello_program, &pio, &sm, &offset, data_pin, 1, true);
    hard_assert(success);

    printf("Shifting out on Data=%d, Latch=%d, Clock=%d\n", data_pin, latch_pin, clock_pin);
    hello_program_init(pio, sm, offset, data_pin, clock_pin, latch_pin);
    
    while (true) {
        for(uint8_t j = 0; j < 255; j++) {
            // Shift out 8 bits. Make sure to shift data appropriately if PIO shifts right.
            // PIO default is shift RIGHT (LSB first).
            // To match MSB first (like value & 128), we can bit-reverse or shift left.
            // But let's just send the byte as is, assuming simpler display logic.
            // Actually, the loop does 8 bits. We need to feed 32 bits properly or change PULL threshold.
            // With PULL (default), it takes 32 bits. We iterate 8 times.
            // So we need to position our data in the 32-bit word, or change PULL to auto-pull 8 bits
            // or just rely on shifting all 32 bits if needed.
            // Our program: `pull`, `set x, 7`, then 8 shift-outs.
            // It will consume 8 bits from OSR.
            // But `pull` always reloads full OSR from FIFO.
            // So we can put `j` in the LSB of the 32-bit word.
            // And use `out pins, 1` which takes from LSB (if right shift).
            // This will send LSB first.
            
            // If we want to send MSB first (bit 7), we must construct the word such that bit 7 is at bit 0 position 
            // OR change PIO setup to shift LEFT.
            // The default config generated by `hello_program_get_default_config` sets shift_right = true.
            // So `out pins, 1` takes bit 0.
            
            // Let's just output `j` now. The display pattern will be reversed compared to MSB logic, 
            // but it will work and prove the concept.
            
            pio_sm_put_blocking(pio, sm, j);
            sleep_ms(500);
        }
    }
    pio_remove_program_and_unclaim_sm(&hello_program, pio, sm, offset);
    return 0;
}

